#include <Arduino.h>
#include <U8g2lib.h>
#include <Wire.h>

// Display setup
U8G2_SSD1306_128X64_NONAME_F_HW_I2C u8g2(U8G2_R0, /* reset=*/ U8X8_PIN_NONE);

// Bitmap dimensions
#define heart_width 128
#define heart_height 32
#define timon_width 128
#define timon_height 51

// Display duration
#define DISPLAY_DURATION 30000  // Duration for case 0 and looping animation (in milliseconds)

// Button and LED setup
#define BUTTON_PIN 7             // Pin for the toggle button
#define DIM_BUTTON_PIN 2         // Pin for the dimming button (non-PWM)
#define LED_PINS {9, 10, 11, 6, 5, 3} // PWM-capable LED pins

// PWM-capable pins for LED control
const int pwmPins[] = {9, 10, 11, 6, 5, 3};

// Debounce settings
const unsigned long debounceDelay = 50;       // Debounce delay for the toggle button
const unsigned long dimDebounceDelay = 50;   // Debounce delay for the dimming button
unsigned long lastDebounceTime = 0;          // Last time toggle button state changed
unsigned long lastDimDebounceTime = 0;       // Last time dimming button state changed

// LED control variables
bool ledState = false;            // Tracks whether LEDs are on or off
bool buttonPressed = false;       // Tracks if the toggle button was pressed
bool dimButtonPressed = false;    // Tracks if the dimming button was pressed

// Brightness control
int currentBrightness = 0;                // Current brightness level (0-255)
const int brightnessSteps[] = {255, 128, 76, 26}; // Brightness levels: 100%, 50%, 30%, 10%
int currentStepIndex = 0;                 // Tracks current brightness step index

// Button state tracking
bool lastButtonState = HIGH;      // Previous state of the toggle button
bool lastDimButtonState = HIGH;   // Previous state of the dimming button



const static unsigned char heart_bits[7][2048] PROGMEM = {
  { // heart 1 - frame 0
    0x00, 0x00, 0x00, 0x00, 0x00, 0x00, 0x00, 0x00, 0x00, 0x00, 0x00, 0x00, 
  0x00, 0x00, 0x00, 0x00, 0x00, 0x00, 0x00, 0x00, 0x00, 0x00, 0x00, 0x00, 
  0x00, 0x00, 0x00, 0x00, 0x00, 0x00, 0x00, 0x00, 0x00, 0x00, 0x00, 0x00, 
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  0x00, 0x00, 0x00, 0x00, 0x00, 0x00, 0x00, 0x00
  },
  { // heart 2 - frame 1
    0x00, 0x00, 0x00, 0x00, 0x00, 0x00, 0x00, 0x00, 0x00, 0x00, 0x00, 0x00, 
  0x00, 0x00, 0x00, 0x00, 0x00, 0x00, 0x00, 0x00, 0x00, 0x00, 0x00, 0x00, 
  0x00, 0x00, 0x00, 0x00, 0x00, 0x00, 0x00, 0x00, 0x00, 0x00, 0x00, 0x00, 
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  0x00, 0x00, 0x00, 0x00, 0x00, 0x00, 0x00, 0x00
  },
  { // heart 3 - frame 2
    0x00, 0x00, 0x00, 0x00, 0x00, 0x00, 0x00, 0x00, 0x00, 0x00, 0x00, 0x00, 
  0x00, 0x00, 0x00, 0x00, 0x00, 0x00, 0x00, 0x00, 0x00, 0x00, 0x00, 0x00, 
  0x00, 0x00, 0x00, 0x00, 0x00, 0x00, 0x00, 0x00, 0x00, 0x00, 0x00, 0x00, 
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  0x00, 0x00, 0x00, 0x00, 0x00, 0x00, 0x00, 0x00
  },
  { // heart 4 - frame 3
    0x00, 0x00, 0x00, 0x00, 0x00, 0x00, 0x00, 0x00, 0x00, 0x00, 0x00, 0x00, 
  0x00, 0x00, 0x00, 0x00, 0x00, 0x00, 0x00, 0x00, 0x00, 0x00, 0x00, 0x00, 
  0x00, 0x00, 0x00, 0x00, 0x00, 0x00, 0x00, 0x00, 0x00, 0x00, 0x00, 0x00, 
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  0x00, 0x00, 0x00, 0x00, 0x00, 0x00, 0x00, 0x00
  },
  { // heart 5 - frame 4
    0x00, 0x00, 0x00, 0x00, 0x00, 0x00, 0x00, 0x00, 0x00, 0x00, 0x00, 0x00, 
  0x00, 0x00, 0x00, 0x00, 0x00, 0x00, 0x00, 0x00, 0x00, 0x00, 0x00, 0x00, 
  0x00, 0x00, 0x00, 0x00, 0x00, 0x00, 0x00, 0x00, 0x00, 0x00, 0x00, 0x00, 
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  0x00, 0x00, 0x00, 0x00, 0x00, 0x00, 0x00, 0x00
  },
  //heart 6 -frame 5
  {
  0xe0, 0xff, 0xff, 0xff, 0xff, 0xff, 0xff, 0xff, 0xff, 0xff, 0xff, 0xff, 0xff, 0x1f, 0x00,
  0x00, 0x10, 0x00, 0x00, 0x00, 0x00, 0x00, 0x00, 0x00, 0x00, 0x00, 0x00, 0x00, 0x00, 0x20,
  0x00, 0x20, 0x08, 0xf8, 0x01, 0x00, 0x00, 0x00, 0x00, 0x00, 0x00, 0x00, 0x00, 0x00, 0x00,
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  0x00, 0x00, 0x00, 0x00
  },
    //timon - frame 6
  {
   0x00, 0x00, 0x00, 0x00, 0x00, 0x00, 0x00, 0x00, 0x00, 0x00, 0x00, 0x00,
   0x00, 0x00, 0x00, 0x00, 0x00, 0x00, 0x00, 0x00, 0x00, 0x00, 0x00, 0x00,
   0x00, 0x00, 0x00, 0x00, 0x00, 0x00, 0x00, 0x00, 0x00, 0x00, 0x00, 0x00,
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   0x08, 0x00, 0x00, 0x00, 0xb4, 0x80, 0x00, 0x00, 0x00, 0x00, 0x00, 0x00 }

};

void drawAnimation(void) {
  static uint8_t frame = 0;          // Current frame index
  static unsigned long phaseStartTime = 0; // Start time of the current phase
  static bool isCase0 = true;        // Flag to track if we are in case 0

  // Get the current time
  unsigned long currentTime = millis();

  // Check if we need to switch phases
  if (currentTime - phaseStartTime >= DISPLAY_DURATION) {
    phaseStartTime = currentTime;  // Reset phase start time
    isCase0 = !isCase0;            // Toggle between case 0 and the animation loop
    frame = isCase0 ? 0 : 1;       // Reset frame index based on phase
  }

  u8g2.clearBuffer();

  if (isCase0) {
    // Case 0: Static display
    u8g2.setFont(u8g2_font_tenthinguys_tr);
    u8g2.drawStr(0, 10, "Love u Mangusta");
    u8g2.drawXBMP(0, 15, timon_width, timon_height, heart_bits[6]);
    u8g2.sendBuffer();
  } else {
    // Loop through other frames as fast as possible
    switch (frame) {
      case 1: u8g2.drawXBMP(0, 15, heart_width, heart_height, heart_bits[0]); break;
      case 2: u8g2.drawXBMP(0, 15, heart_width, heart_height, heart_bits[1]); break;
      case 3: u8g2.drawXBMP(0, 15, heart_width, heart_height, heart_bits[2]); break;
      case 4: u8g2.drawXBMP(0, 15, heart_width, heart_height, heart_bits[3]); break;
      case 5: u8g2.drawXBMP(0, 15, heart_width, heart_height, heart_bits[4]); break;
      case 6: u8g2.drawXBMP(0, 15, heart_width, heart_height, heart_bits[4]); break;
      case 7: u8g2.drawXBMP(0, 15, heart_width, heart_height, heart_bits[4]); break;
      case 8: u8g2.drawXBMP(0, 15, heart_width, heart_height, heart_bits[3]); break;
      case 9: u8g2.drawXBMP(0, 15, heart_width, heart_height, heart_bits[2]); break;
      case 10: u8g2.drawXBMP(0, 15, heart_width, heart_height, heart_bits[1]); break;
      case 11: u8g2.drawXBMP(0, 15, heart_width, heart_height, heart_bits[0]); break;
    }
    u8g2.sendBuffer();

    // Advance to the next frame
    frame++;
    if (frame > 11) {
      frame = 1; // Loop back to the first frame in the animation
    }
  }
}

// Function to toggle all LEDs
void toggleAllLEDs(bool state, int brightness) {
  // Loop through each pin in pwmPins array
  for (int i = 0; i < sizeof(pwmPins) / sizeof(pwmPins[0]); i++) {
    // If LEDs should be on, set the specified brightness
    if (state) {
      analogWrite(pwmPins[i], brightness);
    } else {
      analogWrite(pwmPins[i], 0); // Turn off LED
    }
  }
}


void setup() {
  // Set pin modes for buttons
  pinMode(BUTTON_PIN, INPUT_PULLUP);     // Toggle button with internal pull-up resistor
  pinMode(DIM_BUTTON_PIN, INPUT_PULLUP); // Dim button with internal pull-up resistor

  // Initialize PWM pins for LEDs
  for (int i = 0; i < sizeof(pwmPins) / sizeof(pwmPins[0]); i++) {
    pinMode(pwmPins[i], OUTPUT);      // Set each PWM pin as output
    analogWrite(pwmPins[i], 0);      // Start with all LEDs off
  }

  // Optionally, initialize the display (if you are using one)
  u8g2.begin();  // Initialize the OLED display (assuming you are using the U8G2 library)
}


void loop() {
  // Read button states
  int buttonReading = digitalRead(BUTTON_PIN);
  int dimButtonReading = digitalRead(DIM_BUTTON_PIN);

  // Handle the toggle button with debounce
  if (buttonReading != lastButtonState) {
    lastDebounceTime = millis(); // Update debounce timer
  }
  if ((millis() - lastDebounceTime) > debounceDelay) { // Check if debounce delay has passed
    if (buttonReading == LOW && !buttonPressed) { // Button was pressed
      ledState = !ledState; // Toggle LED state
      toggleAllLEDs(ledState, brightnessSteps[currentStepIndex]); // Apply the current brightness step
      buttonPressed = true; // Mark button as pressed
    } else if (buttonReading == HIGH) { 
      buttonPressed = false; // Reset flag when button is released
    }
  }

  // Handle the dimming button with debounce
  if (dimButtonReading != lastDimButtonState) {
    lastDimDebounceTime = millis(); // Update debounce timer for dimming button
  }
  if ((millis() - lastDimDebounceTime) > dimDebounceDelay) { // Check if debounce delay has passed
    if (dimButtonReading == LOW && !dimButtonPressed) { // Dim button pressed
      // Move to the next dimming step
      currentStepIndex++;
      if (currentStepIndex >= sizeof(brightnessSteps) / sizeof(brightnessSteps[0])) {
        currentStepIndex = 0; // Loop back to full brightness
      }

      // If LEDs are on, update brightness
      if (ledState) {
        toggleAllLEDs(true, brightnessSteps[currentStepIndex]); // Set LEDs to the new brightness
      }
      dimButtonPressed = true; // Mark dimming button as pressed
    } else if (dimButtonReading == HIGH) {
      dimButtonPressed = false; // Reset flag when dimming button is released
    }
  }

  // Update last button states for the next loop
  lastButtonState = buttonReading;
  lastDimButtonState = dimButtonReading;

  // Draw the animation on the display
  u8g2.firstPage();
  do {
    drawAnimation(); // Call the drawing function (make sure you have implemented this function)
  } while (u8g2.nextPage()); // Display the contents of the page
}
